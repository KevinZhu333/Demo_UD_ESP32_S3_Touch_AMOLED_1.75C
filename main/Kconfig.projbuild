## main/Kconfig.projbuild
```kconfig
menu "Project Runtime Configuration"

    config WIFI_MANAGER_SSID
        string "Wi-Fi station SSID"
        default ""
        help
            SSID for Wi-Fi station mode. Leave empty to initialize networking
            but skip connection attempts.

    config WIFI_MANAGER_PASSWORD
        string "Wi-Fi station password"
        default ""
        help
            Password for Wi-Fi station mode. Keep real credentials in local
            sdkconfig/menuconfig output, not in tracked defaults.

    config RUNTIME_CONFIG_CLOUD_AUDIO_SEGMENT_URL
        string "Cloud audio segment upload URL"
        default ""
        help
            HTTP endpoint that receives closed WAV segments, for example
            http://host:8000/v1/device/audio-segments. Leave empty to record
            local segments without cloud upload.

    config RUNTIME_CONFIG_DEVICE_ID
        string "Device ID"
        default "esp32s3-dev"
        help
            Non-secret device identity sent to the cloud transport.

    config RUNTIME_CONFIG_COLLECTION_TOKEN
        string "Collection token"
        default ""
        help
            Temporary v1 collection token. Leave empty to allow networking while
            blocking audio upload until a local config provides a real token.

    config AUDIO_SEGMENT_SECONDS
        int "Audio segment duration seconds"
        default 10
        range 10 300
        help
            Duration of each closed WAV segment before it is queued for upload.
            At 16 kHz stereo PCM16, 10 seconds is about 640 KB before headers.

endmenu
```
